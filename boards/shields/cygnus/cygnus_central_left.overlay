/*
 * Copyright (c) 2021 The ZMK Contributors
 *
 * SPDX-License-Identifier: MIT
 */

#include "cygnus.dtsi"

&default_kscan {
    compatible = "zmk,kscan-gpio-matrix";
    wakeup-source;
    diode-direction = "col2row";

// КОЛОНКИ (Col)
    col-gpios
        = <&gpio0 9  GPIO_ACTIVE_HIGH> // Была Col 5, теперь Col 1 (Q, A, Z)
        , <&gpio0 24 GPIO_ACTIVE_HIGH> // Была Col 4, теперь Col 2 (W, S, X)
        , <&gpio1 11 GPIO_ACTIVE_HIGH> // Col 3 (E, D, C) - осталась в центре
        , <&gpio0 31 GPIO_ACTIVE_HIGH> // Была Col 2, теперь Col 4 (R, F, V)
        , <&gpio0 29 GPIO_ACTIVE_HIGH> // Была Col 1, теперь Col 5 (T, G, B)
        ;

    // СТРОКИ (Row)
    row-gpios
        = <&gpio0 30 (GPIO_ACTIVE_HIGH | GPIO_PULL_DOWN)> // Row 1: P0.30 (D17)
        , <&gpio0 2  (GPIO_ACTIVE_HIGH | GPIO_PULL_DOWN)> // Row 2: P0.02 (D14)
        , <&gpio0 13 (GPIO_ACTIVE_HIGH | GPIO_PULL_DOWN)> // Row 3: P0.13 (D5)
        , <&gpio0 20 (GPIO_ACTIVE_HIGH | GPIO_PULL_DOWN)> // Row 4: P0.20 (D4)
        ;
};
